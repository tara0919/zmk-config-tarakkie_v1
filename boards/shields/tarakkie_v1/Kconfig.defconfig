## boards/shields/tarakkie_v1/Kconfig.defconfig
```kconfig
# Copyright (c) 2025 The ZMK Contributors
# SPDX-License-Identifier: MIT

if SHIELD_TARAKKIE_V1_LEFT

config ZMK_KEYBOARD_NAME
    default "Tarakkie v1"

config ZMK_SPLIT_ROLE_CENTRAL
    default y

endif

if SHIELD_TARAKKIE_V1_LEFT || SHIELD_TARAKKIE_V1_RIGHT

config ZMK_SPLIT
    default y

endif
```

## boards/shields/tarakkie_v1/Kconfig.shield
```kconfig
# Copyright (c) 2025 The ZMK Contributors
# SPDX-License-Identifier: MIT

config SHIELD_TARAKKIE_V1_LEFT
    def_bool $(shields_list_contains,tarakkie_v1_left)

config SHIELD_TARAKKIE_V1_RIGHT
    def_bool $(shields_list_contains,tarakkie_v1_right)
```
